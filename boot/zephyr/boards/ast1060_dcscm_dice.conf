## boot/zephyr/boards/ast1060_dcscm_dice.conf
```kconfig
CONFIG_DYNAMIC_INTERRUPTS=y
CONFIG_SPI=y
CONFIG_SPI_ASPEED=y
CONFIG_FLASH_SIZE=0
CONFIG_FLASH_MAP=y
CONFIG_FLASH_BASE_ADDRESS=0x0
CONFIG_SINGLE_APPLICATION_SLOT=n
CONFIG_BOOT_SWAP_USING_MOVE=n
CONFIG_SPI_NOR=n
CONFIG_SPI_NOR_MULTI_DEV=y
CONFIG_CRYPTO=y
CONFIG_CRYPTO_ASPEED=y
CONFIG_WATCHDOG=y
CONFIG_WDT_ASPEED=y
#CONFIG_OTP_SIM=y
CONFIG_OTP_ASPEED=y
CONFIG_GPIO=y
CONFIG_GPIO_ASPEED=y
CONFIG_BASE64=y
CONFIG_BOOT_RAM_LOAD=y
CONFIG_BOOT_IMAGE_EXECUTABLE_RAM_START=0x30000
CONFIG_BOOT_IMAGE_EXECUTABLE_RAM_SIZE=393216
CONFIG_BOOTLOADER_MCUBOOT=n

# RSA
#CONFIG_BOOT_SIGNATURE_TYPE_RSA=y

# ECDSA256
CONFIG_BOOT_SIGNATURE_TYPE_ECDSA_P256=y
CONFIG_BOOT_ECDSA_P256_USE_MBEDTLS=y
```
